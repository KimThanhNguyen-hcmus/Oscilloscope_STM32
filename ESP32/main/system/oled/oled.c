#include "my_oled.h"
#include "driver/i2c_master.h"
#include "esp_log.h"

uint8_t oled_buffer[1024];
i2c_master_dev_handle_t oled_handle;
const uint8_t font5x7[][5] = {
    {0x00, 0x00, 0x00, 0x00, 0x00}, // Space (0x20)
    {0x00, 0x00, 0x5f, 0x00, 0x00}, // !
    {0x00, 0x07, 0x00, 0x07, 0x00}, // "
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    {0x61, 0x51, 0x49, 0x45, 0x43}, // Z
};
void I2C_Config()
{
    /*-------Master-------*/
    i2c_master_bus_config_t i2c_mst_config = {
        .clk_source = I2C_CLK_SRC_DEFAULT,
        .i2c_port = 0,
        .scl_io_num = 22,
        .sda_io_num = 21,
        .glitch_ignore_cnt = 7,
        .flags.enable_internal_pullup = true,
    };

    i2c_master_bus_handle_t bus_handle;
    ESP_ERROR_CHECK(i2c_new_master_bus(&i2c_mst_config, &bus_handle));

    i2c_device_config_t dev_cfg = {
        .dev_addr_length = I2C_ADDR_BIT_LEN_7,
        .device_address = 0x3C,
        .scl_speed_hz = 100000,
    };
    ESP_ERROR_CHECK(i2c_master_bus_add_device(bus_handle, &dev_cfg, &oled_handle));
}
void OLED_WriteCmd(uint8_t cmd)
{
    uint8_t buffer[2] = {0x00, cmd};
    i2c_master_transmit(oled_handle, buffer, 2, -1);
}
void OLED_Init()
{
    uint8_t init_cmds[] = {
        0xAE,
        0x20, 0x00,
        0xC8,
        0xA1,
        0x81, 0xFF,
        0xAF};
    for (int i = 0; i < sizeof(init_cmds); i++)
    {
        OLED_WriteCmd(init_cmds[i]);
    }
}
void OLED_Clear()
{
    memset(oled_buffer, 0, sizeof(oled_buffer));
}
void OLED_Update()
{
    OLED_WriteCmd(0x21);
    OLED_WriteCmd(0);
    OLED_WriteCmd(127);
    OLED_WriteCmd(0x22);
    OLED_WriteCmd(0);
    OLED_WriteCmd(7);
    uint8_t send_buf[1025];
    send_buf[0] = 0x40;
    memcpy(&send_buf[1], oled_buffer, 1024);
    i2c_master_transmit(oled_handle, send_buf, 1025, -1);
}
void OLED_DrawPixel(int x, int y, uint8_t color)
{
    if (x < 0 || x >= 128 || y < 0 || y > 63)
        return;
    if (color)
    {
        oled_buffer[x + (y / 8) * 128] |= (1 << (y % 8));
    }
    else
    {
        oled_buffer[x + (y / 8) * 128] &= ~(1 << (y % 8));
    }
}
void OLED_DrawChar(int x, int y, char c)
{
    if (c < 0x20 || c > 0x5A)
        return;
    int font_idx = c - 0x20;
    for (int col = 0; col < 5; col++)
    {
        uint8_t line = font5x7[font_idx][col];
        for (int row = 0; row < 8; row++)
        {
            if (line & (1 << row))
            {
                OLED_DrawPixel(x + col, y + row, 1);
            }
        }
    }
}
void OLED_DrawString(int x, int y, const char *str)
{
    while (*str)
    {
        OLED_DrawChar(x, y, *str);
        x += 6;
        str++;
    }
}
void OLED_DrawGrid()
{
    for (int x = 0; x < 128; x++)
    {
        if (x % 2 == 0)
            OLED_DrawPixel(x, 41, 1);
    }
    for (int x = 32; x < 128; x += 32)
    {
        for (int y = 20; y < 64; y += 4)
        {
            OLED_DrawPixel(x, y, 1);
        }
    }
}
void OLED_DrawWaveForm()
{
    OLED_Clear();
    OLED_DrawGrid();
    int offset = 0;
    float gain = 1.0;
    uint16_t raw_max = 0;
    uint16_t raw_min = 4095;
    for (int i = 0; i < 128; i++)
    {
        uint16_t val = adc_val[i * 8];
        if (val > raw_max)
            raw_max = val;
        if (val < raw_min)
            raw_min = val;
    }
    float v_max_volt = (raw_max * 3.3) / 4095.0;
    float v_min_volt = (raw_min * 3.3) / 4095.0;
    float v_pp = v_max_volt - v_min_volt;

    char str_vmax[20];
    char str_vpp[20];

    sprintf(str_vmax, "MAX:%.2fV", v_max_volt);
    sprintf(str_vpp, "VPP:%.2fV", v_pp);

    OLED_DrawString(0, 0, str_vmax);
    OLED_DrawString(0, 10, str_vpp);

    for (int x = 0; x < 128; x++)
    {
        uint16_t sample = adc_val[x * 8];
        int y = 63 - (int)((float)sample * gain * 43.0 / 4095.0);
        if (y < 20)
            y = 20;
        if (y > 63)
            y = 63;
        OLED_DrawPixel(x, y, 1);
    }
    OLED_Update();
}
